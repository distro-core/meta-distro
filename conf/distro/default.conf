## conf/distro/distro-core.conf
```bitbake
# DISTRO.conf

# Used to define DISTRO with GUI

# Aspects of build-in inclusion are denoted with the use of an OVERRIDE from
# DISTROOVERRIDES. Where functionality is only available from a specific Yocto
# meta-* layer, incorporate the appropriate conditional checks and test with
# that layer absent.

# OVERRIDES                 Description
# none                      default required even if empty
# :${DISTRO}                additions based on DISTRO
# :${DISTRO_CODENAME}       additions based on DISTRO_CODENAME
# :distro-guest             additions for virtual machine guests
# :distro-gui               additions for gnome, xfce, wayland, x11
# :distro-kubernetes        additions for kubernetes, k3s
# :distro-kvm               additions for kvm, lxc, libvirt
# :distro-testfw            additions for test frameworks
# :libc-glibc               additions for runtime glibc, locales
# :libc-musl                additions for runtime musl
# :<distrooverride>         additions for DISTROOVERRIDES

DISTROOVERRIDES =. "${DISTRO_CODENAME}:"
DISTROOVERRIDES =. "distro-gui:"

# Inherit from DISTRO poky
TCLIBC = "glibc"
TCLIBCAPPEND = "-${TCLIBC}"
require conf/distro/poky.conf

DISTRO = "distro-core"
require conf/distro/include/distro-version.inc

DISTRO_NAME = "DISTRO Core (${DISTRO})"
MAINTAINER = "RPM Signing <release@internal>"

TARGET_VENDOR = "-distro"

SDK_VENDOR = "-distro${TCLIBC}"
SDK_VERSION = "${DISTRO_VERSION}"
SDK_VERSION[vardepvalue] = "${SDK_VERSION}"

SDKMACHINE ?= "x86_64"

# selects "mdev-busybox", "systemd", "sysvinit"
INIT_MANAGER = "systemd"

# features
DISTRO_FEATURES:append = " \
integrity security virtualization sota usrmerge ${INIT_MANAGER} \
acl audit efi overlayfs pam pci usbgadget usbhost \
tpm tpm2 wifi bluetooth polkit selinux \
ipsec ipv4 ipv6 luks seccomp \
"

DISTRO_FEATURES:append = " \
opengl pulseaudio vulkan wayland x11 \
"

DISTRO_FEATURES:append:distro-testfw = " \
ptest \
"

DISTRO_FEATURES:remove = " \
3g api-documentation ima nfc nfs pcmcia zeroconf smbfs \
modsign \
"

DISTRO_EXTRA_RDEPENDS:append = ""

DISTRO_FEATURES:append:class-native = " usrmerge ${INIT_MANAGER}"

# ---
```

## conf/distro/distro-musl-gui.conf
```bitbake
# DISTRO.conf

# Used to define DISTRO with GUI

# Aspects of build-in inclusion are denoted with the use of an OVERRIDE from
# DISTROOVERRIDES. Where functionality is only available from a specific Yocto
# meta-* layer, incorporate the appropriate conditional checks and test with
# that layer absent.

# OVERRIDES                 Description
# none                      default required even if empty
# :${DISTRO}                additions based on DISTRO
# :distro-guest             additions for virtual machine guests
# :distro-gui               additions for gnome, xfce, wayland, x11
# :distro-kubernetes        additions for kubernetes, k3s
# :distro-kvm               additions for kvm, lxc, libvirt
# :distro-testfw            additions for test frameworks
# :libc-glibc               additions for runtime glibc, locales
# :libc-musl                additions for runtime musl
# :<distrooverride>         additions for DISTROOVERRIDES

DISTROOVERRIDES =. "distro-core:"
DISTROOVERRIDES =. "distro-full:"
# DISTROOVERRIDES =. "distro-guest:"
DISTROOVERRIDES =. "distro-gui:"
# DISTROOVERRIDES =. "distro-kubernetes:"
# DISTROOVERRIDES =. "distro-kvm:"
# DISTROOVERRIDES =. "distro-testfw:"

# Inherit from DISTRO poky
require conf/distro/poky.conf
require conf/multiconfig/mc-tclibc-musl.conf

DISTRO = "distro-musl-gui"

DISTRO_VERSION = "0.2.0"
DISTRO_NAME = "Distro Core (${DISTRO})"
MAINTAINER = "RPM Signing <release@internal>"

TARGET_VENDOR = "-distro"

SDK_VENDOR = "-distro${TCLIBC}"
SDK_VERSION = "${DISTRO_VERSION}"
SDK_VERSION[vardepvalue] = "${SDK_VERSION}"

SDKMACHINE ?= "x86_64"

# selects "mdev-busybox", "systemd", "sysvinit"
INIT_MANAGER = "sysvinit"

# features
DISTRO_FEATURES:append = " \
integrity security virtualization sota usrmerge ${INIT_MANAGER} \
acl audit efi overlayfs pam pci usbgadget usbhost \
tpm tpm2 wifi bluetooth selinux \
gobject-introspection-data ipsec ipv4 ipv6 luks seccomp \
"

DISTRO_FEATURES:append:distro-gui = " \
opengl pulseaudio vulkan wayland x11 polkit \
"

DISTRO_FEATURES:append:distro-testfw = " \
ptest \
"

DISTRO_FEATURES:remove = " \
3g api-documentation ima nfc nfs pcmcia zeroconf smbfs \
modsign \
"

DISTRO_EXTRA_RDEPENDS:append = ""

DISTRO_FEATURES:append:class-native = " usrmerge ${INIT_MANAGER}"

# ---
```

## conf/distro/distro-tiny.conf
```bitbake
# DISTRO.conf

# Used to define DISTRO with CLI

# Aspects of build-in inclusion are denoted with the use of an OVERRIDE from
# DISTROOVERRIDES. Where functionality is only available from a specific Yocto
# meta-* layer, incorporate the appropriate conditional checks and test with
# that layer absent.

# OVERRIDES                 Description
# none                      default required even if empty
# :${DISTRO}                additions based on DISTRO
# :${DISTRO_CODENAME}       additions based on DISTRO_CODENAME
# :distro-guest             additions for virtual machine guests
# :distro-gui               additions for gnome, xfce, wayland, x11
# :distro-kubernetes        additions for kubernetes, k3s
# :distro-kvm               additions for kvm, lxc, libvirt
# :distro-testfw            additions for test frameworks
# :libc-glibc               additions for runtime glibc, locales
# :libc-musl                additions for runtime musl
# :<distrooverride>         additions for DISTROOVERRIDES

require conf/distro/poky-tiny.conf

DISTRO_FEATURES = "${DISTRO_CORE_DEFAULT_DISTRO_FEATURES}"

DISTROOVERRIDES =. "${DISTRO_CODENAME}:"
# DISTROOVERRIDES =. "distro-gui:"

TCLIBC = "musl"

require conf/distro/include/distro-version.inc

# SDK_VENDOR = "${TARGET_VENDOR}${TCLIBC}"
# SDK_VERSION = "${DISTRO_VERSION}"
# SDK_VERSION[vardepvalue] = "${SDK_VERSION}"

SDKMACHINE ?= "x86_64"

# features
DISTRO_CORE_DEFAULT_DISTRO_FEATURES = "${DISTRO_FEATURES_DEFAULT} ${POKY_DEFAULT_DISTRO_FEATURES}  \
sota usrmerge \
efi overlayfs pam pci \
wifi polkit \
ipv4 ipv6 seccomp \
"

DISTRO_FEATURES:remove = " \
opengl pulseaudio vulkan wayland x11 \
3g api-documentation ima nfc nfs pcmcia zeroconf smbfs \
modsign \
"

DISTRO_EXTRA_RDEPENDS:append = ""

# selects "mdev-busybox", "systemd", "sysvinit"
INIT_MANAGER = "mdev-busybox"

DISTRO_FEATURES += "mdev-busybox"
# DISTRO_FEATURES_BACKFILL_CONSIDERED = "sysvinit"

# virtual runtime
# VIRTUAL-RUNTIME_base-utils = ""
# VIRTUAL-RUNTIME_base-utils-hwclock = ""
# VIRTUAL-RUNTIME_base-utils-nsenter = "util-linux-nsenter"
# VIRTUAL-RUNTIME_container_dns = "cni"
# VIRTUAL-RUNTIME_container_engine = "docker-moby"
# VIRTUAL-RUNTIME_container_networking = "cni"
# VIRTUAL-RUNTIME_container_orchestration = "k3s"
# VIRTUAL-RUNTIME_container_runtime = "virtual-runc"
# VIRTUAL-RUNTIME_dev_manager = "systemd"
# VIRTUAL-RUNTIME_graphical_init_manager = "gdm"
# VIRTUAL-RUNTIME_graphical_init_manager:libc-musl = "lxdm"
# VIRTUAL-RUNTIME_init_manager = "systemd"
# VIRTUAL-RUNTIME_initscripts = ""
# VIRTUAL-RUNTIME_keymaps = "keymaps"
# VIRTUAL-RUNTIME_login_manager = "shadow"
# VIRTUAL-RUNTIME_network_manager = "networkmanager"
# VIRTUAL-RUNTIME_syslog = ""
# VIRTUAL-RUNTIME_xserver_common = "xserver-xorg"
# PREFERRED_PROVIDER_virtual/base-utils = ""

DISTRO_FEATURES:append:class-native = " usrmerge ${INIT_MANAGER}"
DISTRO_FEATURES:append:class-nativesdk = " usrmerge ${INIT_MANAGER}"

# ---
```

## conf/distro/include/distro-clang.inc
```bitbake
# conf/distro/include/distro-clang.inc

# Used to support clang as alternative compiler

# make additions for nonclangable and nonscanable to the appropriate
# sections below. TOOLCHAIN only effective when clang layer is available.

# selects "clang", "gcc"
TOOLCHAIN ?= "clang"
# if "1", include clang in sdk
CLANGSDK = "0"

# if set, selects c/c++ runtime from "gnu" or "llvm"
# TC_CXX_RUNTIME = "gnu"

# CLANG_EXTRA_OE_VENDORS:append = " ${DISTRO}"

# override provider of llvm
PREFERRED_PROVIDER_llvm:toolchain-clang = "clang"
PREFERRED_PROVIDER_llvm-native:toolchain-clang = "clang-native"
PREFERRED_PROVIDER_nativesdk-llvm:toolchain-clang = "nativesdk-clang"

# override provider of llvm
PROVIDES:pn-clang += "llvm"
PROVIDES:pn-clang-native += "llvm-native"
PROVIDES:pn-nativesdk-clang += "nativesdk-llvm"

# force clang per recipe
# TOOLCHAIN:forcevariable = "clang"
# DEPENDS:append:toolchain-clang = " clang-cross-${TARGET_ARCH}"

# nonclangable.conf TOOLCHAIN additions

# KERNEL_CC:toolchain-clang = "${CCACHE}clang ${HOST_CC_KERNEL_ARCH} -fuse-ld=lld ${DEBUG_PREFIX_MAP} -fdebug-prefix-map=${STAGING_KERNEL_DIR}=${KERNEL_SRC_PATH}"
# KERNEL_LD:toolchain-clang = "${CCACHE}ld.lld"
# KERNEL_AR:toolchain-clang = "${CCACHE}llvm-ar"

LTO:pn-efitools = ""

TOOLCHAIN:pn-acl = "gcc"
TOOLCHAIN:pn-btrfs-tools = "gcc"
TOOLCHAIN:pn-containerd-opencontainers = "gcc"
TOOLCHAIN:pn-coreutils = "gcc"
TOOLCHAIN:pn-efitools = "gcc"
TOOLCHAIN:pn-efivar = "gcc"
TOOLCHAIN:pn-ethtool = "gcc"
TOOLCHAIN:pn-flex = "gcc"
TOOLCHAIN:pn-gdbm = "gcc"
TOOLCHAIN:pn-gmp = "gcc"
TOOLCHAIN:pn-gnome-system-monitor = "gcc"
TOOLCHAIN:pn-gpgme = "gcc"
TOOLCHAIN:pn-libgudev = "gcc"
TOOLCHAIN:pn-libjxl = "gcc"
TOOLCHAIN:pn-libnl = "gcc"
TOOLCHAIN:pn-libpam = "gcc"
TOOLCHAIN:pn-libseccomp = "gcc"
TOOLCHAIN:pn-libxml2 = "gcc"
TOOLCHAIN:pn-lxc = "gcc"
TOOLCHAIN:pn-m4 = "gcc"
TOOLCHAIN:pn-mlvpn = "gcc"
TOOLCHAIN:pn-nettle = "gcc"
TOOLCHAIN:pn-openssl-tpm-engine = "gcc"
TOOLCHAIN:pn-ostree = "gcc"
TOOLCHAIN:pn-ostree-devicetrees = "gcc"
TOOLCHAIN:pn-ostree-initramfs = "gcc"
TOOLCHAIN:pn-ostree-kernel = "gcc"
TOOLCHAIN:pn-ostree-switchroot = "gcc"
TOOLCHAIN:pn-pcr-extend = "gcc"
TOOLCHAIN:pn-rsync = "gcc"
TOOLCHAIN:pn-runc-opencontainers = "gcc"
TOOLCHAIN:pn-sed = "gcc"
TOOLCHAIN:pn-seloader = "gcc"
TOOLCHAIN:pn-shim = "gcc"
TOOLCHAIN:pn-tini = "gcc"
TOOLCHAIN:pn-util-linux = "gcc"
# TOOLCHAIN:pn-webkitgtk = "gcc"

CFLAGS:append:pn-gtk+:toolchain-clang = " -Wno-error=incompatible-function-pointer-types"
CFLAGS:append:pn-libgee:toolchain-clang = " -Wno-error=incompatible-function-pointer-types"
CFLAGS:append:pn-gnome-font-viewer:toolchain-clang = " -Wno-error=incompatible-function-pointer-types"
CFLAGS:append:pn-tpm2-tss-engine:toolchain-clang = " -Wno-error=incompatible-function-pointer-types"
# CFLAGS:append:pn-webkitgtk:toolchain-clang = " -Wno-error=incompatible-function-pointer-types"
# CFLAGS:append:pn-webkitgtk3:toolchain-clang = " -Wno-error=incompatible-function-pointer-types"

# TOOLCHAIN:pn-${PREFERRED_PROVIDER_virtual/kernel} = "gcc"
# OBJCOPY:pn-${PREFERRED_PROVIDER_virtual/kernel}:toolchain-clang = "${HOST_PREFIX}objcopy"

# nonscanable.conf TOOLCHAIN additions

SCAN_BUILD:pn-alsa-state = ""
SCAN_BUILD:pn-bc = ""
SCAN_BUILD:pn-boost = ""
SCAN_BUILD:pn-c-ares = ""
SCAN_BUILD:pn-cjson = ""
SCAN_BUILD:pn-compose-file = ""
SCAN_BUILD:pn-container-host-config = ""
SCAN_BUILD:pn-containerd-opencontainers = ""
SCAN_BUILD:pn-efitools = ""
SCAN_BUILD:pn-expat = ""
SCAN_BUILD:pn-go-capability = ""
SCAN_BUILD:pn-go-cli = ""
SCAN_BUILD:pn-go-connections = ""
SCAN_BUILD:pn-go-context = ""
SCAN_BUILD:pn-go-dbus = ""
SCAN_BUILD:pn-go-digest = ""
SCAN_BUILD:pn-go-distribution = ""
SCAN_BUILD:pn-go-errors = ""
SCAN_BUILD:pn-go-fsnotify = ""
SCAN_BUILD:pn-go-logrus = ""
SCAN_BUILD:pn-go-mux = ""
SCAN_BUILD:pn-go-patricia = ""
SCAN_BUILD:pn-go-pty = ""
SCAN_BUILD:pn-go-runtime = ""
SCAN_BUILD:pn-go-systemd = ""
SCAN_BUILD:pn-gps-time-sync = ""
SCAN_BUILD:pn-grpc-go = ""
SCAN_BUILD:pn-grub-bootconf = ""
SCAN_BUILD:pn-hostapd = ""
SCAN_BUILD:pn-ima-policy = ""
SCAN_BUILD:pn-initrdscripts-ima = ""
SCAN_BUILD:pn-initrdscripts-secure-core = ""
SCAN_BUILD:pn-intel-microcode = ""
SCAN_BUILD:pn-internal-docker-network = ""
SCAN_BUILD:pn-iproute2 = ""
SCAN_BUILD:pn-iw = ""
SCAN_BUILD:pn-json-c = ""
SCAN_BUILD:pn-key-store = ""
SCAN_BUILD:pn-libwebsockets = ""
SCAN_BUILD:pn-make-mod-scripts = ""
SCAN_BUILD:pn-modem-mgr = ""
SCAN_BUILD:pn-ncurses = ""
SCAN_BUILD:pn-nlohmann-json = ""
SCAN_BUILD:pn-notary = ""
SCAN_BUILD:pn-oci-image-spec = ""
SCAN_BUILD:pn-oci-image-tools = ""
SCAN_BUILD:pn-oci-runtime-spec = ""
SCAN_BUILD:pn-oci-runtime-tools = ""
SCAN_BUILD:pn-openssh = ""
SCAN_BUILD:pn-openssl-tpm-engine = ""
SCAN_BUILD:pn-ostree-kernel-initramfs = ""
SCAN_BUILD:pn-paho-mqtt-c = ""
SCAN_BUILD:pn-paho-mqtt-cpp = ""
SCAN_BUILD:pn-python3-atomicwrites = ""
SCAN_BUILD:pn-python3-attrs = ""
SCAN_BUILD:pn-python3-importlib-metadata = ""
SCAN_BUILD:pn-python3-iniconfig = ""
SCAN_BUILD:pn-python3-more-itertools = ""
SCAN_BUILD:pn-python3-packaging = ""
SCAN_BUILD:pn-python3-paho-mqtt = ""
SCAN_BUILD:pn-python3-pathlib2 = ""
SCAN_BUILD:pn-python3-pluggy = ""
SCAN_BUILD:pn-python3-py = ""
SCAN_BUILD:pn-python3-pyparsing = ""
SCAN_BUILD:pn-python3-pyserial = ""
SCAN_BUILD:pn-python3-pytest = ""
SCAN_BUILD:pn-python3-pyudev = ""
SCAN_BUILD:pn-python3-setuptools = ""
SCAN_BUILD:pn-python3-six = ""
SCAN_BUILD:pn-python3-tomli = ""
SCAN_BUILD:pn-python3-wcwidth = ""
SCAN_BUILD:pn-python3-zipp = ""
SCAN_BUILD:pn-rsync = ""
SCAN_BUILD:pn-runc-opencontainers = ""
SCAN_BUILD:pn-sftp = ""
SCAN_BUILD:pn-shadow-sysroot = ""
SCAN_BUILD:pn-spf13-cobra = ""
SCAN_BUILD:pn-spf13-pflag = ""
SCAN_BUILD:pn-sudo = ""
SCAN_BUILD:pn-systemd-bootconf = ""
SCAN_BUILD:pn-systemd-compat-units = ""
SCAN_BUILD:pn-systemd-conf = ""
SCAN_BUILD:pn-systemd-journald = ""
SCAN_BUILD:pn-systemd-mm = ""
SCAN_BUILD:pn-systemd-serialgetty = ""
SCAN_BUILD:pn-tailscale = ""
SCAN_BUILD:pn-tini = ""
SCAN_BUILD:pn-tunctl = ""
SCAN_BUILD:pn-unzip = ""
SCAN_BUILD:pn-uthash = ""
SCAN_BUILD:pn-watchdog-config = ""
SCAN_BUILD:pn-yajl = ""
SCAN_BUILD:pn-zip = ""

# ---
```
