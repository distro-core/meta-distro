## conf/distro/sota.conf.inc
```bitbake
# included by conf/distro/distro-common.conf
# original at meta-updater/conf/sota.conf.inc

# Used to setup sota from meta-updater

DISTRO_FEATURES:append = " sota usrmerge"
DISTRO_FEATURES_NATIVE:append = " sota usrmerge"

INHERIT += "sota"

# for persistence, set in environment to override, export OSTREE_REPO='<path>'
OSTREE_REPO = "${DEPLOY_DIR}/ostree_repo"
# refs branch
OSTREE_BRANCHNAME = "${DISTRO}-${MACHINE}_${BPN}_${DISTRO_VERSION}"

# disable default tarball creation
BUILD_OSTREE_TARBALL = "0"
BUILD_OTA_TARBALL = "0"

# enable specific tarball creation .tar.gz
IMAGE_FSTYPES:append:sota = " ostree.tar.gz ota.tar.gz"

# undesired build artifacts by OVERRIDES
IMAGE_FSTYPES:remove:sota = "image_repo_manifest ostreepush garagesign garagecheck ota-btrfs ota-ext4 wic"

OSTREE_OSNAME ?= "${DISTRO}"
OSTREE_BOOTLOADER ?= "none"
OSTREE_BOOT_PARTITION = "${EFI_PREFIX}"
OSTREE_KERNEL = "${KERNEL_IMAGETYPE}"
OSTREE_DEPLOY_DEVICETREE ?= "1"
OSTREE_DEVICETREE = "${KERNEL_DEVICETREE}"
OSTREE_MULTI_DEVICETREE_SUPPORT ?= "0"
OSTREE_SYSROOT_READONLY = "1"
OSTREE_KERNEL_ARGS = "${APPEND}"

# gpg signing (keys.conf)
# OSTREE_GPGDIR = "${MASTER_KEYS_DIR}/rpm_keys"
# OSTREE_GPGID = "RPM Signing"
# OSTREE_GPG_PASSPHRASE = "passphrase"
# OSTREE_GRUB_PW_FILE = "${GRUB_PW_FILE}"
# EXTRA_OSTREE_COMMIT:append = "--gpg-sign=${OSTREE_GPGID} --gpg-homedir=${OSTREE_GPGDIR}"

OSTREE_COMMIT_SUBJECT ?= "Commit-id: ${OSTREE_BRANCHNAME}"
# OSTREE_COMMIT_BODY ?= ""
OSTREE_COMMIT_VERSION ?= "${DISTRO_VERSION}"
# OSTREE_UPDATE_SUMMARY ?= "1"

# https://ostreedev.github.io/ostree/man/ostree.repo-config.html
OSTREE_REPO_CONFIG = " \
core.add-remotes-config-dir:true \
core.min-free-space-size:1024MB \
sysroot.bootloader=auto \
"

# https://ostreedev.github.io/ostree/man/ostree.repo-config.html
OSTREE_OTA_REPO_CONFIG = " \
core.add-remotes-config-dir:true \
core.min-free-space-size:1024MB \
sysroot.bootloader=auto \
"

# from files/user-keys/keys.conf
OSTREE_GPG_SIGN_ARGS = "${@'--gpg-sign=${OSTREE_GPGID}' if d.getVar('OSTREE_GPGID') else ''}"
OSTREE_GPG_HOMEDIR_ARGS = "${@'--gpg-homedir=${OSTREE_GPGDIR}' if d.getVar('OSTREE_GPGDIR') else ''}"
# EXTRA_OSTREE_COMMIT:append = " ${OSTREE_GPG_SIGN_ARGS} ${OSTREE_GPG_HOMEDIR_ARGS}"

SOTA_MACHINE = "none"
SOTA_MACHINE:sota = "none"
SOTA_MACHINE:intel-corei7-64 = "none"

# EXTRA_IMAGECMD:ota-ext4 = "-L otaroot -i 4096 -t ext4"
# -O quota -E quotatype=usrquota:grpquota:prjquota
EXTRA_IMAGECMD:ota-ext4 = "-b 4096 -i 4096 -t ext4 -L '${FSYS_DEV_NAME_ROOT}' -U ${FSYS_DEV_UUID_ROOT}"

# EXTRA_IMAGECMD:ota-btrfs = "-L otaroot -n 4096 --shrink"
# -O quota
EXTRA_IMAGECMD:ota-btrfs = "-s 4096 -n 4096 --shrink -L '${FSYS_DEV_NAME_ROOT}' -U ${FSYS_DEV_UUID_ROOT}"

# ---
```

## conf/layer.conf
```bitbake
# LAYER.conf

# Use in BBLAYERS.CONF following poky/meta and poky/meta-poky
# such that the prepend places this layer at the front of BBPATH

BBPATH =. "${LAYERDIR}:"

BBFILES += " \
${LAYERDIR}/recipes-*/*/*.bb \
${LAYERDIR}/recipes-*/*/*.bbappend \
"

BBFILE_COLLECTIONS += "distro-core"
BBFILE_PATTERN_distro-core = "^${LAYERDIR}/"
BBFILE_PRIORITY_distro-core = "12"

# Requied dependency layers that are present in every build
LAYERDEPENDS_distro-core = "core yocto openembedded-layer networking-layer sota"
LAYERSERIES_COMPAT_distro-core = "kirkstone scarthgap"

# commit info for inclusion in os-release

BUILD_COMMIT_DATE := "${@os.popen('cd ${LAYERDIR} ; git log -1 --pretty=format:%cI 2>/dev/null').read().strip()}"

BUILD_COMMIT_REF := "${@next( \
    (ref.split('/')[-1] for ref in os.popen('cd ${LAYERDIR} ; git describe --tags --exact-match HEAD 2>/dev/null').read().strip().split() or \
     os.popen('cd ${LAYERDIR} ; git name-rev --name-only HEAD 2>/dev/null').read().strip().split() \
     if 'remotes/' in ref or ref not in ['undefined', 'HEAD']), \
    os.popen('cd ${LAYERDIR} ; git rev-parse --short HEAD 2>/dev/null').read().strip() \
)}"

BUILD_COMMIT_AUTHOR := "${@os.popen('cd ${LAYERDIR} ; git log -1 --pretty=format:%cE 2>/dev/null').read().strip()}"

# https://docs.yoctoproject.org/ref-manual/variables.html?highlight=bbfiles_dynamic#term-BBFILES_DYNAMIC
# pathing is used roughly matching bblayers.conf; these locations are for .bb or .bbappends

BBFILES_DYNAMIC += " \
clang-layer:${LAYERDIR}/dynamic-layers/meta-clang/*/*/*.bb \
clang-layer:${LAYERDIR}/dynamic-layers/meta-clang/*/*/*.bbappend \
meta-mingw:${LAYERDIR}/dynamic-layers/meta-clang/*/*/*.bb \
meta-mingw:${LAYERDIR}/dynamic-layers/meta-clang/*/*/*.bbappend \
openembedded-layer:${LAYERDIR}/dynamic-layers/meta-oe/*/*/*.bb \
openembedded-layer:${LAYERDIR}/dynamic-layers/meta-oe/*/*/*.bbappend \
filesystems-layer:${LAYERDIR}/dynamic-layers/meta-filesystems/*/*/*.bb \
filesystems-layer:${LAYERDIR}/dynamic-layers/meta-filesystems/*/*/*.bbappend \
networking-layer:${LAYERDIR}/dynamic-layers/meta-networking/*/*/*.bb \
networking-layer:${LAYERDIR}/dynamic-layers/meta-networking/*/*/*.bbappend \
perl-layer:${LAYERDIR}/dynamic-layers/meta-perl/*/*/*.bb \
perl-layer:${LAYERDIR}/dynamic-layers/meta-perl/*/*/*.bbappend \
meta-python:${LAYERDIR}/dynamic-layers/meta-python/*/*/*.bb \
meta-python:${LAYERDIR}/dynamic-layers/meta-python/*/*/*.bbappend \
selinux:${LAYERDIR}/dynamic-layers/meta-selinux/*/*/*.bb \
selinux:${LAYERDIR}/dynamic-layers/meta-selinux/*/*/*.bbappend \
sota:${LAYERDIR}/dynamic-layers/meta-updater/*/*/*.bb \
sota:${LAYERDIR}/dynamic-layers/meta-updater/*/*/*.bbappend \
virtualization-layer:${LAYERDIR}/dynamic-layers/meta-virtualization/*/*/*.bb \
virtualization-layer:${LAYERDIR}/dynamic-layers/meta-virtualization/*/*/*.bbappend \
gnome-layer:${LAYERDIR}/dynamic-layers/meta-gnome/*/*/*.bb \
gnome-layer:${LAYERDIR}/dynamic-layers/meta-gnome/*/*/*.bbappend \
multimedia-layer:${LAYERDIR}/dynamic-layers/meta-multimedia/*/*/*.bb \
multimedia-layer:${LAYERDIR}/dynamic-layers/meta-multimedia/*/*/*.bbappend \
meta-initramfs:${LAYERDIR}/dynamic-layers/meta-initramfs/*/*/*.bb \
meta-initramfs:${LAYERDIR}/dynamic-layers/meta-initramfs/*/*/*.bbappend \
webserver:${LAYERDIR}/dynamic-layers/meta-webserver/*/*/*.bb \
webserver:${LAYERDIR}/dynamic-layers/meta-webserver/*/*/*.bbappend \
xfce-layer:${LAYERDIR}/dynamic-layers/meta-xfce/*/*/*.bb \
xfce-layer:${LAYERDIR}/dynamic-layers/meta-xfce/*/*/*.bbappend \
dpdk:${LAYERDIR}/dynamic-layers/meta-dpdk/*/*/*.bb \
dpdk:${LAYERDIR}/dynamic-layers/meta-dpdk/*/*/*.bbappend \
intel:${LAYERDIR}/dynamic-layers/meta-intel/*/*/*.bb \
intel:${LAYERDIR}/dynamic-layers/meta-intel/*/*/*.bbappend \
raspberrypi:${LAYERDIR}/dynamic-layers/meta-raspberrypi/*/*/*.bb \
raspberrypi:${LAYERDIR}/dynamic-layers/meta-raspberrypi/*/*/*.bbappend \
tegra:${LAYERDIR}/dynamic-layers/meta-tegra/*/*/*.bb \
tegra:${LAYERDIR}/dynamic-layers/meta-tegra/*/*/*.bbappend \
security:${LAYERDIR}/dynamic-layers/meta-security/*/*/*.bb \
security:${LAYERDIR}/dynamic-layers/meta-security/*/*/*.bbappend \
integrity:${LAYERDIR}/dynamic-layers/meta-integrity/*/*/*.bb \
integrity:${LAYERDIR}/dynamic-layers/meta-integrity/*/*/*.bbappend \
tpm-layer:${LAYERDIR}/dynamic-layers/meta-tpm/*/*/*.bb \
tpm-layer:${LAYERDIR}/dynamic-layers/meta-tpm/*/*/*.bbappend \
secure-core:${LAYERDIR}/dynamic-layers/meta-secure-core/*/*/*.bb \
secure-core:${LAYERDIR}/dynamic-layers/meta-secure-core/*/*/*.bbappend \
efi-secure-boot:${LAYERDIR}/dynamic-layers/meta-efi-secure-boot/*/*/*.bb \
efi-secure-boot:${LAYERDIR}/dynamic-layers/meta-efi-secure-boot/*/*/*.bbappend \
encrypted-storage:${LAYERDIR}/dynamic-layers/meta-encrypted-storage/*/*/*.bb \
encrypted-storage:${LAYERDIR}/dynamic-layers/meta-encrypted-storage/*/*/*.bbappend \
signing-key:${LAYERDIR}/dynamic-layers/meta-signing-key/*/*/*.bb \
signing-key:${LAYERDIR}/dynamic-layers/meta-signing-key/*/*/*.bbappend \
tpm2:${LAYERDIR}/dynamic-layers/meta-tpm2/*/*/*.bb \
tpm2:${LAYERDIR}/dynamic-layers/meta-tpm2/*/*/*.bbappend \
"

# ---
```
