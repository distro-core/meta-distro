## conf/distro/include/distro-providers.conf
```bitbake
# require conf/distro/include/local-versions.conf

# Used to pin specific packages and versions

# virtual runtime
VIRTUAL-RUNTIME_keymaps ??= "keymaps"
VIRTUAL-RUNTIME_syslog ??= "syslog-ng"

VIRTUAL-RUNTIME_container_engine ??= "docker-moby"
VIRTUAL-RUNTIME_container_runtime ??= "virtual-runc"
VIRTUAL-RUNTIME_container_networking ??= "cni"
# VIRTUAL-RUNTIME_container_orchestration ??= "k3s"
VIRTUAL-RUNTIME_base-utils-nsenter ??= "util-linux-nsenter"

VIRTUAL-RUNTIME_xserver_common ??= "xserver-xorg"
# if "", default xserver-nodm-init
VIRTUAL-RUNTIME_graphical_init_manager ??= "gdm"

PREFERRED_PROVIDER_virtual/libgl ??= "mesa"
PREFERRED_PROVIDER_virtual/libgles1 ??= "mesa"
PREFERRED_PROVIDER_virtual/libgles2 ??= "mesa"
PREFERRED_PROVIDER_virtual/libgles3 ??= "mesa"
PREFERRED_PROVIDER_virtual/xserver ??= "xserver-xorg"
PREFERRED_PROVIDER_virtual/runc ??= "runc-opencontainers"

PREFERRED_RPROVIDER_network-configuration ??= "networkd-dhcp-conf"
PREFERRED_RPROVIDER_virtual/psplash ??= "psplash"

PREFERRED_RPROVIDER_util-linux-fsck-native = "util-linux-fsck-native"
PREFERRED_RPROVIDER_util-linux-agetty-native = "util-linux-agetty-native"
PREFERRED_RPROVIDER_util-linux-mount-native = "util-linux-mount-native"
PREFERRED_RPROVIDER_util-linux-umount-native = "util-linux-umount-native"

# preferred versions
# PREFERRED_VERSION_shim = "15.8"

# Explicitly removed packages
PACKAGE_EXCLUDE:append = " util-linux-more"

# rpi-default-providers.inc
# PREFERRED_PROVIDER_virtual/kernel:sbc-raspberrypi5 ??= "linux-raspberrypi"
# PREFERRED_PROVIDER_virtual/xserver:sbc-raspberrypi5 ?= "xserver-xorg"
PREFERRED_PROVIDER_virtual/egl:sbc-raspberrypi5 ?= "${@bb.utils.contains("MACHINE_FEATURES", "vc4graphics", "mesa", "userland", d)}"
PREFERRED_PROVIDER_virtual/libgles2:sbc-raspberrypi5 ?= "${@bb.utils.contains("MACHINE_FEATURES", "vc4graphics", "mesa", "userland", d)}"
PREFERRED_PROVIDER_virtual/libgl:sbc-raspberrypi5 ?= "${@bb.utils.contains("MACHINE_FEATURES", "vc4graphics", "mesa", "mesa-gl", d)}"
PREFERRED_PROVIDER_virtual/mesa:sbc-raspberrypi5 ?= "${@bb.utils.contains("MACHINE_FEATURES", "vc4graphics", "mesa", "mesa-gl", d)}"
PREFERRED_PROVIDER_virtual/libgbm:sbc-raspberrypi5 ?= "${@bb.utils.contains("MACHINE_FEATURES", "vc4graphics", "mesa", "mesa-gl", d)}"
PREFERRED_PROVIDER_vlc:sbc-raspberrypi5 ?= "rpidistro-vlc"
PREFERRED_PROVIDER_ffmpeg:sbc-raspberrypi5 ?= "rpidistro-ffmpeg"
PREFERRED_PROVIDER_libav:sbc-raspberrypi5 ?= "rpidistro-ffmpeg"
PREFERRED_PROVIDER_libpostproc:sbc-raspberrypi5 ?= "rpidistro-ffmpeg"
PREFERRED_PROVIDER_jpeg:sbc-raspberrypi5 ?= "jpeg"
PREFERRED_PROVIDER_virtual/libomxil:sbc-raspberrypi5 ?= "userland"
PREFERRED_PROVIDER_u-boot-default-script:sbc-raspberrypi5 ??= "rpi-u-boot-scr"

# ---
```

## conf/distro/include/distro-providers.inc
```bitbake
# conf/distro/include/distro-providers.inc

# Used to pin specific packages and versions

PREFERRED_PROVIDER_virtual/runc ??= "runc-opencontainers"

PREFERRED_RPROVIDER_network-configuration ??= "networkd-dhcp-conf"
PREFERRED_RPROVIDER_virtual/psplash ??= "psplash"

# PREFERRED_RPROVIDER_util-linux-more = "busybox"

PREFERRED_RPROVIDER_util-linux-fsck-native = "util-linux-fsck-native"
PREFERRED_RPROVIDER_util-linux-agetty-native = "util-linux-agetty-native"
PREFERRED_RPROVIDER_util-linux-mount-native = "util-linux-mount-native"
PREFERRED_RPROVIDER_util-linux-umount-native = "util-linux-umount-native"

# preferred versions
# PREFERRED_VERSION_shim = "15.8"
PREFERRED_VERSION_wpa-supplicant = "2.11"

# Explicitly removed packages
# PACKAGE_EXCLUDE:append = " util-linux-more"

# distro-tiny default providers
PREFERRED_PROVIDER_virtual/containerd:distro-tiny ??= ""

# QA sanity overrides
# INSANE_SKIP:cni ??= "ldflags ldflags already-stripped textrel"
# INSANE_SKIP:fwupd-ptest ??= "buildpaths"
# INSANE_SKIP:gettext-ptest ??= "build-deps"
# INSANE_SKIP:libjcat-ptest ??= "buildpaths"
# INSANE_SKIP:libvirt ??= "build-deps"
# INSANE_SKIP:libvirt-python ??= "buildpaths"
# INSANE_SKIP:m4-ptest ??= "build-deps"
# INSANE_SKIP:python3-ptest ??= "build-deps"
INSANE_SKIP:bash-completion-ptest ??= "build-deps"
INSANE_SKIP:bash-ptest ??= "build-deps"
INSANE_SKIP:expat-ptest ??= "build-deps file-rdeps"
INSANE_SKIP:fuse3 ??= "build-deps"
INSANE_SKIP:gawk-ptest ??= "build-deps"
INSANE_SKIP:gcab ??= "buildpaths"
INSANE_SKIP:geary ??= "buildpaths"
INSANE_SKIP:geary-dbg ??= "buildpaths"
INSANE_SKIP:glib-2.0-ptest ??= "build-deps"
INSANE_SKIP:gnome-tweaks ??= "buildpaths"
INSANE_SKIP:gnupg-ptest ??= "build-deps"
INSANE_SKIP:gnutls-ptest ??= "build-deps file-rdeps"
INSANE_SKIP:grub-common ??= "build-deps"
INSANE_SKIP:libcamera ??= "32bit-time"
INSANE_SKIP:libcheck-ptest ??= "build-deps file-rdeps"
INSANE_SKIP:libgpg-error-ptest ??= "build-deps"
INSANE_SKIP:libpcre-ptest ??= "build-deps"
INSANE_SKIP:libseccomp-ptest ??= "build-deps file-rdeps"
INSANE_SKIP:lua-ptest ??= "build-deps file-rdeps"
INSANE_SKIP:mozjs ??= "32bit-time"
INSANE_SKIP:openrc-stub = "usrmerge"
INSANE_SKIP:pipewire ??= "32bit-time"
INSANE_SKIP:popt-ptest ??= "build-deps"
INSANE_SKIP:strace-ptest ??= "build-deps"
INSANE_SKIP:volume-key ??= "buildpaths"
INSANE_SKIP:zlib-ptest ??= "build-deps"

INSANE_SKIP:rust-crosssdk ??= "uppercase-pn"

# ---
```

## conf/distro/include/distro-rust.conf
```bitbake
# conf/distro/include/distro-rust.conf

require ${@bb.utils.contains('BBFILE_COLLECTIONS', 'rust-layer', 'conf/distro/include/rust_versions.inc', '', d)}

# ---
```

## conf/distro/include/distro-rust.inc
```bitbake
# conf/distro/include/distro-rust.inc

RUST_VERSION = "1.75.0"

# require conf/distro/include/rust_security_flags.inc
require ${@bb.utils.contains('BBFILE_COLLECTIONS', 'rust-layer', 'conf/distro/include/rust_versions.inc', '', d)}

# ---
```

## conf/distro/include/distro-useradd.inc
```bitbake
# conf/distro/include/distro-useradd.inc

# Used to define group and passwd mappings

# static gids
USERADD_GID_TABLES += "files/static-group"

# static uids
USERADD_UID_TABLES += "files/static-passwd"

# if "useradd-staticids", dynamic useradd will check against static lists
USERADDEXTENSION = "useradd-staticids"

# if "error", dynamic useradd generate error if not in static lists
USERADD_ERROR_DYNAMIC = "error"

# ---
```

## conf/distro/include/distro-version.conf
```bitbake
# conf/distro/include/distro-version.conf

# DISTRO Version
DISTRO_VERSION = "0.0.0"

# ---
```

## conf/distro/include/distro-version.inc
```bitbake
# conf/distro/include/distro-version.inc

DISTRO = "distro-core"
DISTRO_VERSION = "0.0.0"

DISTRO_NAME = "DISTRO Core (${DISTRO} ${TCLIBC})"
MAINTAINER = "RPM Signing <release@internal>"

TARGET_VENDOR = "-distro"

# ---
```

## conf/distro/include/local-build.conf
```bitbake
# require by conf/local.conf

# lower than nominal priority, allows system functions to run
BB_NICE_LEVEL ??= "5"
# lower than nominal priority, allows system functions to run
BB_TASK_NICE_LEVEL ??= "6"
# logging configuration, output to ${TOPDIR}
BB_LOGCONFIG = "${TOPDIR}/../../layers/meta-distro/conf/logging-conf.json"
# if "1", bbappends without recipe are warning only
BB_DANGLINGAPPENDS_WARNONLY = "1"
# BB_MULTI_PROVIDER_ALLOWED = "1"

# UEFI variables VENDOR_UUID
VENDOR_UUID ??= "186dc214-eb89-430a-95e9-1a9bf4ad8923"

# GLIBC_GENERATE_LOCALES += "en_US.UTF-8"
# image language
# IMAGE_LINGUAS += "en-us"
# CORE_IMAGE_EXTRA_INSTALL += "glibc-locale-en-us"

# SDKMACHINE ??= "x86_64-mingw32"
# if "1", uses DEBUG_OPTIMIZATION flags
DEBUG_BUILD = "0"
# compiler optimization flags
FULL_OPTIMIZATION = "-Os -pipe ${DEBUG_FLAGS}"
DEBUG_OPTIMIZATION = "-Og -pipe ${DEBUG_FLAGS}"
SELECTED_OPTIMIZATION = "${@d.getVar(oe.utils.vartrue('DEBUG_BUILD', 'DEBUG_OPTIMIZATION', 'FULL_OPTIMIZATION', d))}"

# set artifacts output paths
DEPLOY_DIR_IPK = "${DEPLOY_DIR}/ipk"
DEPLOY_DIR_RPM = "${DEPLOY_DIR}/rpm"
DEPLOY_DIR_DEB = "${DEPLOY_DIR}/deb"
DEPLOY_DIR_IMAGE = "${DEPLOY_DIR}/images"
DEPLOY_DIR_TOOLS = "${DEPLOY_DIR}/tools"
# DEPLOY_DIR_SRC = "${DEPLOY_DIR}/src"
# SSTATE_ALLOW_OVERLAP_FILES += "${DEPLOY_DIR_IMAGE}/microcode"

# icecream compatible sstate signatures
# INHERIT += "icecc"
# ICECC_DISABLED ??= "1"

# runtime
TCMODE ??= "default"
# TCLIBC ??= "glibc"
# TCLIBCAPPEND = "-${TCLIBC}"

# if "1", do not install package recommendations
NO_RECOMMENDATIONS = "1"

# multiconfig
# BBMULTICONFIG:append = " mc-tclibc-glibc mc-tclibc-musl"

# base-passwd, root home ~root
ROOT_HOME = "/root"

# if "no", /var/log is persistent
VOLATILE_LOG_DIR = "no"
# if "no", /var/tmp is persistent
VOLATILE_TMP_DIR = "no"

# rm_work
INHERIT += "rm_work"
# optional. if set, package work is not removed
RM_WORK_EXCLUDE = ""

# cve-check
INHERIT:remove = "cve-check"
require conf/distro/include/cve-extra-exclusions.inc
# optional, if "0", patched cve are not reported
# CVE_CHECK_REPORT_PATCHED = "0"
# optional, if "0", warnings are not issued
# CVE_CHECK_SHOW_WARNINGS = "0"
# optional, if set, packages are skipped, allow list
# CVE_CHECK_SKIP_RECIPE = ""
# optional, if set, frequency of database updates
# CVE_DB_UPDATE_INTERVAL = "0"
# optional, if set, annotation of cve status
# CVE_STATUS[CVE-2000-00001] = "not-applicable-platform: Issue only applies on Windows"

# create-spdx
INHERIT:remove = "create-spdx"
# optional. if "1", output spdx files will be formatted
# SPDX_PRETTY = "1"
# optional. if "1", output spdx files includes [file-information section](https://spdx.github.io/spdx-spec/v2.3/file-information/)
# SPDX_INCLUDE_SOURCES = "0"
# optional. if "1", bitbake will create source files archive for each package
# SPDX_ARCHIVE_SOURCES = "0"
# optional. if "1", bitbake will create output binary archive for each package
# SPDX_ARCHIVE_PACKAGED = "0"

# buildhistory
INHERIT:remove = "buildhistory"
# optional. if "0", bitbake will not commit buildhistory
BUILDHISTORY_COMMIT = "0"

# buildinfo ${sysconfdir}/build
INHERIT += "image-buildinfo"
IMAGE_BUILDINFO_FILE = "${sysconfdir}/buildinfo"

# license archives management
INHERIT += "license"
# if "1", copy licenses to image
COPY_LIC_DIRS = "0"
# if "1", copy license manifest to image
COPY_LIC_MANIFEST = "1"
# if set, licenses to exclude from source archives
COPYLEFT_LICENSE_EXCLUDE = "CLOSED Proprietary"
# if "1", create license packages
LICENSE_CREATE_PACKAGE = "0"

# license-audit INCOMPATIBLE_LICENSE
INHERIT += "license-audit"
INCOMPATIBLE_LICENSE:tegra = ""

# license flags
LICENSE_FLAGS_ACCEPTED:remove = "commercial_ffmpeg"
QT_COMMERCIAL_MODULES = "0"

# QA warning/error configuration, override in package INSANE_SKIP = "flag"
# WARN_QA += ""
# ERROR_QA += ""

# inherit remove .la, override in package REMOVE_LIBTOOL_LA = "0"
# INHERIT += "remove-libtool"

# package management (deb, ipk, rpm)
# PACKAGE_CLASSES += "package_ipk"
# PACKAGE_CLASSES += "package_deb"
# PACKAGE_CLASSES += "package_rpm"
# INHERIT += "sign_ipk"
# INHERIT += "sign_rpm"
# INHERIT += "sign_package_feed"
# INHERIT += "${PACKAGE_CLASSES}"

# user-key-store
# require files/user-keys/keys.conf
# INHERIT += "user-key-store"

# ---
```

## conf/distro/include/local-mirrors.conf
```bitbake
# require by conf/local.conf

# set build the hostname or IP
# MIRROR_BUILD_SERVER = "build"

# remote downloads
# INHERIT += "own-mirrors"
# SOURCE_MIRROR_URL ?= "https://${MIRROR_BUILD_SERVER}/downloads"

# remote sstate-cache
# SSTATE_MIRRORS ?= "file://.* https://${MIRROR_BUILD_SERVER}/sstate-cachePATH"
# SSTATE_MIRROR_ALLOW_NETWORK = "1"

# remote bitbake-hashserv; requires running bitbake-servers.service
# server: bitbake-hashserv --bind :8686 &
# BB_HASHSERVE ?= "0.0.0.0:8686"
# BB_HASHSERVE ?= "${MIRROR_BUILD_SERVER}:8686"

# remote bitbake-prserv; requires running bitbake-servers.service
# server: bitbake-prserv --host 0.0.0.0 --port 8585 --start
# PRSERV_HOST ?= "0.0.0.0:8585"
# PRSERV_HOST ?= "${MIRROR_BUILD_SERVER}:8585"

# DL_DIR git and tarball generation
BB_GIT_SHALLOW = "1"
BB_GIT_SHALLOW_DEPTH = "1"
BB_GENERATE_MIRROR_TARBALLS ?= "1"
BB_GENERATE_SHALLOW_TARBALLS ?= "1"

# ---
```

## conf/distro/include/local-versions.conf
```bitbake
# require by conf/local.conf

# virtual runtime
VIRTUAL-RUNTIME_keymaps ??= "keymaps"
VIRTUAL-RUNTIME_syslog ??= "syslog-ng"

VIRTUAL-RUNTIME_container_engine ??= "docker-moby"
VIRTUAL-RUNTIME_container_runtime ??= "virtual-runc"
VIRTUAL-RUNTIME_container_networking ??= "cni"
# VIRTUAL-RUNTIME_container_orchestration ??= "k3s"
VIRTUAL-RUNTIME_base-utils-nsenter ??= "util-linux-nsenter"

VIRTUAL-RUNTIME_xserver_common ??= "xserver-xorg"
# if "", default xserver-nodm-init
VIRTUAL-RUNTIME_graphical_init_manager ??= "gdm"

PREFERRED_PROVIDER_virtual/libgl ??= "mesa"
PREFERRED_PROVIDER_virtual/libgles1 ??= "mesa"
PREFERRED_PROVIDER_virtual/libgles2 ??= "mesa"
PREFERRED_PROVIDER_virtual/libgles3 ??= "mesa"
PREFERRED_PROVIDER_virtual/xserver ??= "xserver-xorg"
PREFERRED_PROVIDER_virtual/runc ??= "runc-opencontainers"

PREFERRED_RPROVIDER_network-configuration ??= "networkd-dhcp-conf"
PREFERRED_RPROVIDER_virtual/psplash ??= "psplash"

PREFERRED_RPROVIDER_util-linux-fsck-native = "util-linux-fsck-native"
PREFERRED_RPROVIDER_util-linux-agetty-native = "util-linux-agetty-native"
PREFERRED_RPROVIDER_util-linux-mount-native = "util-linux-mount-native"
PREFERRED_RPROVIDER_util-linux-umount-native = "util-linux-umount-native"

# preferred versions
# PREFERRED_VERSION_shim = "15.8"

# Explicitly removed packages
PACKAGE_EXCLUDE:append = " util-linux-more"

# ---
```
