## conf/machine/include/machine-uefi.conf
```bitbake
# require by MACHINE.conf

require conf/image-uefi.conf

# The distro is created to support encrypted at rest for partitions except
# partition1 and partition2. The partition1 is mounted to /efi and the
# partition2 is mounted to /boot; neither partition is encrypted at rest.
# This is generally the best practice with a modern linux distro using
# systemd.

# efi prefix /efi or /boot/efi
EFI_PREFIX = "/boot/efi"

# meta-secure-core /efi/EFI/BOOT or /boot/efi/EFI/BOOT
EFI_BOOT_PATH = "${EFI_PREFIX}${EFIDIR}"

# systemd bootctl https://manpages.debian.org/bookworm/systemd-boot/bootctl.1.en.html
# --esp-path=${D}/efi --boot-path=${D}/boot --root=${D}

# ---
```

## conf/machine/include/machine-wic.inc
```bitbake
# conf/machine/include/machine-wic.inc

# Used to supply wic parameters

# undesired build artifacts
IMAGE_FSTYPES:remove = "wic"
IMAGE_FSTYPES:remove:sota = "ota-btrfs ota-ext4"

# scripts/lib/wic/canned-wks
WKS_FILE:sota = "${MACHINE}.wks.in"

WKS_FILE_DEPENDS:append = " systemd-bootconf"
WKS_FILE_DEPENDS_BOOTLOADERS = "syslinux grub-efi systemd-boot os-release u-boot"
WKS_FILE_DEPENDS_BOOTLOADERS:tegra = "l4t-launcher grub-efi systemd-boot os-release"

IMAGE_SECUREBOOT_KEYS_DIR = "${TOPDIR}/../../layers/meta-distro/files/user-keys/uefi_sb_keys"

IMAGE_BOOT_FILES = " \
${KERNEL_IMAGETYPE}-${MACHINE}${KERNEL_ARTIFACT_BIN_EXT};${KERNEL_IMAGETYPE} \
${INITRAMFS_IMAGE}-${MACHINE}.${INITRAMFS_FSTYPES};initrd.img \
systemd-boot${EFI_ARCH}.efi;EFI/BOOT/boot${EFI_ARCH}.efi \
"

# partition1
IMAGE_EFI_BOOT_FILES = " \
systemd-boot${EFI_ARCH}.efi;EFI/BOOT/boot${EFI_ARCH}.efi \
systemd-boot${EFI_ARCH}.efi;EFI/systemd/systemd-boot${EFI_ARCH}.efi \
ext2_${EFI_ARCH}.efi;EFI/systemd/drivers/ext2_${EFI_ARCH}.efi \
ext4_${EFI_ARCH}.efi;EFI/systemd/drivers/ext4_${EFI_ARCH}.efi \
btrfs_${EFI_ARCH}.efi;EFI/systemd/drivers/btrfs_${EFI_ARCH}.efi \
"

# partition1
# IMAGE_EFI_BOOT_FILES_label-${GPT_PART_NAME_ESP} = ""

# partition2
# IMAGE_EFI_BOOT_FILES_label-${GPT_PART_NAME_XBOOTLDR} = ""

# ---
```

## conf/machine/sbc-gene-bt05.conf
```bitbake
# MACHINE.conf

# Intel Baytrail, Atom Aaeon GENE-BT05
# https://www.aaeon.com/en/p/3-and-half-inches-subcompact-boards-gene-bt05

# Aspects of build-in inclusion are denoted with the use of an OVERRIDE from
# MACHINEOVERRIDES. Where functionality is only available from a specific Yocto
# meta-* layer, incorporate the appropriate conditional checks and test with
# that layer absent.

# OVERRIDES                 Description
# none                      default packagegroup, required even if empty
# :${MACHINE}               additions based on MACHINE
# :libc-glibc               additions for runtime glibc, locales
# :libc-musl                additions for runtime musl
# :<machineoverride>        additions for MACHINEOVERRIDES

MACHINEOVERRIDES =. "intel-core2-32:"

# DEFAULTTUNE = "core2-64"

# EFI bootloader
EFI_PROVIDER = "grub-efi"
# meta-updater bootloader
OSTREE_BOOTLOADER = "grub"

require conf/machine/intel-core2-32.conf

# machine features
MACHINE_FEATURES += "acpi alsa bluetooth efi keyboard pci rtc screen serial usbgadget usbhost wifi tpm"
MACHINE_FEATURES:remove = "intel-ucode pcbios pcmcia phone tpm2"

# machine firmware
LICENSE_FLAGS_ACCEPTED:append = ""

# runqemu
# QEMUARCH = "x86"

# build artifacts
# IMAGE_FSTYPES += "ext4"
IMAGE_FSTYPES:remove = "image_repo_manifest ostreepush garagesign garagecheck ota-btrfs ota-ext4 wic"

require conf/machine/include/machine-common.inc
require conf/machine/include/machine-bootloader-${EFI_PROVIDER}.inc
require conf/machine/include/machine-providers.inc
# require ${@bb.utils.contains('IMAGE_FSTYPES', 'wic', 'conf/machine/include/machine-wic.inc', '', d)}

# initramfs (meta-updater assumes only one FSTYPES)
INITRAMFS_FSTYPES = "cpio.gz"
INITRAMFS_IMAGE = "initramfs"
INITRAMFS_MAXSIZE = "393216"
INITRAMFS_IMAGE_BUNDLE = "0"

# if "1", generate warnings for missing features
KERNEL_DANGLING_FEATURES_WARN_ONLY = "1"

# kernel
# PREFERRED_PROVIDER_virtual/kernel = "linux-intel"
KMACHINE = "intel-core2-32"
KTYPE = "standard"
KCONFIG_MODE = "allnoconfig"
KCONF_AUDIT_LEVEL = "0"
KCONF_BSP_AUDIT_LEVEL = "0"

# initial command line
APPEND = "panic=120 net.ifnames=1 audit=1"

# used by systemd-serialgetty or shadow-securetty
SERIAL_CONSOLES = "115200;ttyS1"

# machine specific boot packages
MACHINE_ESSENTIAL_EXTRA_RDEPENDS = ""

# KERNEL_MODULE_AUTOLOAD += "cdc-mbim qmi-wwan qcserial usb-wwan"

# KERNEL_MODULE_PROBECONF += "ath9k"
# module_conf_ath9k = "blacklist ath9k"
# MACHINE_EXTRA_RDEPENDS += "linux-firmware-ath9k"

# KERNEL_MODULE_PROBECONF += "brcmdhd"
# module_conf_brcmdhd = "blacklist brcmdhd"
# MACHINE_EXTRA_RDEPENDS: += "linux-firmware-bcm4329-fullmac"

# ---
```

## conf/machine/sbc-pine64-star64.conf
```bitbake
# MACHINE.conf

# Raspberry Pi 5
# https://www.raspberrypi.com/products/raspberry-pi-5/

# Aspects of build-in inclusion are denoted with the use of an OVERRIDE from
# MACHINEOVERRIDES. Where functionality is only available from a specific Yocto
# meta-* layer, incorporate the appropriate conditional checks and test with
# that layer absent.

# OVERRIDES                 Description
# none                      default packagegroup, required even if empty
# :${MACHINE}               additions based on MACHINE
# :libc-glibc               additions for runtime glibc, locales
# :libc-musl                additions for runtime musl
# :<machineoverride>        additions for MACHINEOVERRIDES

MACHINEOVERRIDES =. "star64:"

DEFAULTTUNE = "riscv64"

# uefi bootloader
EFI_PROVIDER = "none"
# meta-updater bootloader
OSTREE_BOOTLOADER = "none"

require conf/machine/star64.conf

# machine features
MACHINE_FEATURES += "keyboard pci rtc screen serial usbgadget usbhost wifi qemu-usermode"
MACHINE_FEATURES:remove = "intel-ucode alsa bluetooth pcbios pcmcia phone efi tpm tpm2"

# machine firmware
LICENSE_FLAGS_ACCEPTED:append = " synaptics-killswitch"

# undesired build artifacts
IMAGE_FSTYPES:remove = " image_repo_manifest ostreepush garagesign garagecheck ota-btrfs ota-ext4 wic"

require conf/machine/include/machine-common.conf
require conf/machine/include/machine-bootloader-${EFI_PROVIDER}.conf

# initramfs (meta-updater assumes only one FSTYPES)
INITRAMFS_FSTYPES = "cpio.gz"
# INITRAMFS_IMAGE = "initramfs"
INITRAMFS_MAXSIZE = "393216"
INITRAMFS_IMAGE_BUNDLE = "0"

# if "1", generate warnings for missing features
KERNEL_DANGLING_FEATURES_WARN_ONLY = "1"

# kernel
# PREFERRED_PROVIDER_virtual/kernel = "linux-raspberrypi"
# KMACHINE = "common-pc-64"
# KTYPE = "standard"
KCONFIG_MODE = "--alldefconfig"

# initial command line
APPEND = "panic=120 net.ifnames=1 audit=1"

# used by systemd-serialgetty or shadow-securetty
SERIAL_CONSOLES = "115200;ttyS1"

# machine specific boot packages
MACHINE_ESSENTIAL_EXTRA_RDEPENDS = ""

# KERNEL_MODULE_AUTOLOAD += "cdc-mbim qmi-wwan qcserial usb-wwan"

# KERNEL_MODULE_PROBECONF += "ath9k"
# module_conf_ath9k = "blacklist ath9k"
# MACHINE_EXTRA_RDEPENDS += "linux-firmware-ath9k"

# KERNEL_MODULE_PROBECONF += "brcmdhd"
# module_conf_brcmdhd = "blacklist brcmdhd"
# MACHINE_EXTRA_RDEPENDS: += "linux-firmware-bcm4329-fullmac"

PACKAGE_FEED_URIS = "https://packages.distro-core.brainhoard.com/${MACHINE}/release packages.distro-core.brainhoard.com/${MACHINE}/updates"
PACKAGE_FEED_BASE_PATHS = "rpm rpm-dev"
PACKAGE_FEED_ARCHS = "all corei7-64"

# ---
```

## conf/machine/sbc-raspberrypi3.conf
```bitbake
# MACHINE.conf

# Raspberry Pi 5
# https://www.raspberrypi.com/products/raspberry-pi-5/

# Aspects of build-in inclusion are denoted with the use of an OVERRIDE from
# MACHINEOVERRIDES. Where functionality is only available from a specific Yocto
# meta-* layer, incorporate the appropriate conditional checks and test with
# that layer absent.

# OVERRIDES                 Description
# none                      default packagegroup, required even if empty
# :${MACHINE}               additions based on MACHINE
# :libc-glibc               additions for runtime glibc, locales
# :libc-musl                additions for runtime musl
# :<machineoverride>        additions for MACHINEOVERRIDES

MACHINEOVERRIDES =. "raspberrypi3-64:"

# DEFAULTTUNE = "armv8-2a"

# EFI bootloader
EFI_PROVIDER = "none"

# meta-updater bootloader
OSTREE_BOOTLOADER = "none"

# selects "mdev-busybox", "systemd", "sysvinit"
INIT_MANAGER = "systemd"

require conf/machine/raspberrypi3-64.conf

# machine features
MACHINE_FEATURES = "alsa bluetooth keyboard pci rtc screen serial usbgadget usbhost wifi vc4graphics"
MACHINE_FEATURES:remove = "efi amd-ucode intel-ucode pcbios pcmcia phone tpm tpm2"

# machine firmware
LICENSE_FLAGS_ACCEPTED:append = " synaptics-killswitch"

# runqemu
# QEMUARCH = "arm64"

# build artifacts
IMAGE_FSTYPES:remove = "ostreepush garagesign garagecheck ota-btrfs ota-ext4 wic tar.bz2"

require conf/machine/include/machine-common.inc
require conf/machine/include/machine-bootloader-${EFI_PROVIDER}.inc
require conf/machine/include/machine-providers.inc
require ${@bb.utils.contains('IMAGE_FSTYPES', 'wic', 'conf/machine/include/machine-wic.inc', '', d)}

# initramfs (meta-updater assumes only one FSTYPES)
INITRAMFS_FSTYPES = "cpio.gz"
# INITRAMFS_IMAGE = "initramfs"
INITRAMFS_MAXSIZE = "393216"
INITRAMFS_IMAGE_BUNDLE = "0"

# if "1", generate warnings for missing features
KERNEL_DANGLING_FEATURES_WARN_ONLY = "1"

# kernel
PREFERRED_PROVIDER_virtual/kernel = "linux-raspberrypi"
KMACHINE = "raspberrypi3-64"
KTYPE = "standard"
KCONFIG_MODE = "allnoconfig"
KCONF_AUDIT_LEVEL = "0"
KCONF_BSP_AUDIT_LEVEL = "0"

# initial command line
APPEND = "panic=120 net.ifnames=1 audit=1"

# used by systemd-serialgetty or shadow-securetty
SERIAL_CONSOLES = "115200;ttyS1"

# machine specific boot packages
MACHINE_ESSENTIAL_EXTRA_RDEPENDS = ""
# CORE_IMAGE_EXTRA_INSTALL:append = ""

# KERNEL_MODULE_AUTOLOAD += "cdc-mbim qmi-wwan qcserial usb-wwan"

# KERNEL_MODULE_PROBECONF += "ath9k"
# module_conf_ath9k = "options ath9k debug=0 nohwcrypt=1 ps_enable=0"
# MACHINE_EXTRA_RDEPENDS += "linux-firmware-ath9k"

# ---
```

## conf/machine/sbc-xavier-nx-devkit.conf
```bitbake
# MACHINE.conf

# Aspects of build-in inclusion are denoted with the use of an OVERRIDE from
# MACHINEOVERRIDES. Where functionality is only available from a specific Yocto
# meta-* layer, incorporate the appropriate conditional checks and test with
# that layer absent.

# OVERRIDES             Description
# none                  default packagegroup, required even if empty
# :libc-glibc           additions for runtime glibc, locales
# :libc-musl            additions for runtime musl
# :<machine_arch>       additions for specific MACHINE

MACHINEOVERRIDES =. "jetson-xavier-nx-devkit-emmc:"
MACHINEOVERRIDES =. "qemuarm64:"

# DEFAULTTUNE = ""

require conf/machine/jetson-xavier-nx-devkit-emmc.conf

# machine features
MACHINE_FEATURES += "efi keyboard pci rtc screen serial usbgadget usbhost wifi qemu-usermode"
MACHINE_FEATURES:remove = "intel-ucode alsa bluetooth pcbios pcmcia phone tpm tpm2"

# preferred providers
# PREFERRED_PROVIDER_virtual/bootloader = "systemd-boot"
# PREFERRED_PROVIDER_virtual/kernel = "linux-yocto"
# PREFERRED_VERSION_linux-yocto = "6.%"

require conf/machine/include/machine-common.conf
require conf/machine/include/machine-uefi.conf
require conf/machine/include/machine-wic.conf
require conf/machine/include/machine-systemd-boot.conf

# INITRAMFS_IMAGE = "initramfs"
INITRAMFS_IMAGE_BUNDLE = "0"
TEGRA_INITRD_INSTALL = ""

# kernel
# KCONF_AUDIT_LEVEL = "0"
# KCONF_BSP_AUDIT_LEVEL = "0"
# KCONFIG_BSP_AUDIT_LEVEL = "0"
KCONFIG_MODE = "--alldefconfig"

# KERNEL_FEATURES += ""

# initial command line
APPEND = "panic=120 net.ifnames=1 audit=1"

# used by systemd-serialgetty or shadow-securetty
SERIAL_CONSOLES = "115200;ttyS1"

# kernel modules
KERNEL_MODULE_AUTOLOAD ??= ""
KERNEL_MODULE_PROBECONF ??= ""

# KERNEL_MODULE_AUTOLOAD += "cdc-mbim qmi-wwan qcserial usb-wwan"

# KERNEL_MODULE_PROBECONF += "ath9k"
# module_conf_ath9k = "blacklist ath9k"
# MACHINE_EXTRA_RDEPENDS += "linux-firmware-ath9k"

# KERNEL_MODULE_PROBECONF += "brcmdhd"
# module_conf_brcmdhd = "blacklist brcmdhd"
# MACHINE_EXTRA_RDEPENDS: += "linux-firmware-bcm4329-fullmac"

# ---
```

## conf/machine/wsl-arm64.conf
```bitbake
# MACHINE.conf

# Intel Baytrail, Core i5/i7 Adlink cExpress-bt Type 6 Compact
# https://www.adlinktech.com/Products/Computer_on_Modules/COMExpressType6Compact/cExpress-BT?lang=en

# Aspects of build-in inclusion are denoted with the use of an OVERRIDE from
# MACHINEOVERRIDES. Where functionality is only available from a specific Yocto
# meta-* layer, incorporate the appropriate conditional checks and test with
# that layer absent.

# OVERRIDES                 Description
# none                      default packagegroup, required even if empty
# :${MACHINE}               additions based on MACHINE
# :libc-glibc               additions for runtime glibc, locales
# :libc-musl                additions for runtime musl
# :<machineoverride>        additions for MACHINEOVERRIDES

MACHINEOVERRIDES =. "qemuarm64:"

# DEFAULTTUNE = "armv8-2a"

# EFI bootloader
EFI_PROVIDER = "none"

# meta-updater bootloader
OSTREE_BOOTLOADER = "none"

# selects "mdev-busybox", "systemd", "sysvinit"
INIT_MANAGER = "systemd"

require conf/machine/qemuarm64.conf

# machine features
DISTRO_FEATURES:remove = " efi-secure-boot"
MACHINE_FEATURES = "acpi alsa keyboard pci rtc screen serial"
MACHINE_FEATURES:remove = "bluetooth efi amd-ucode intel-ucode pcbios pcmcia usbgadget usbhost phone tpm tpm2 wifi"

# machine firmware
LICENSE_FLAGS_ACCEPTED:append = ""

# runqemu
# QEMUARCH = "arm64"

# build artifacts
IMAGE_CLASSES:remove = "distro-image-usrmerge"
IMAGE_FSTYPES += "wsl"
IMAGE_FSTYPES:remove = "ostreepush garagesign garagecheck ota-btrfs ota-ext4 wic ostree ostreecommit ota ostree.tar.gz ota.tar.gz tar.bz2"

require conf/machine/include/machine-common.inc
require conf/machine/include/machine-bootloader-${EFI_PROVIDER}.inc
require conf/machine/include/machine-providers.inc
require ${@bb.utils.contains('IMAGE_FSTYPES', 'wic', 'conf/machine/include/machine-wic.inc', '', d)}

# initramfs (meta-updater assumes only one FSTYPES)
INITRAMFS_FSTYPES = "cpio.gz"
INITRAMFS_IMAGE = ""
INITRAMFS_MAXSIZE = "393216"
INITRAMFS_IMAGE_BUNDLE = "0"

# if "1", generate warnings for missing features
KERNEL_DANGLING_FEATURES_WARN_ONLY = "1"

# kernel
PREFERRED_PROVIDER_virtual/kernel = "linux-dummy"
KMACHINE = "qemuarm64"
KTYPE = "standard"
KCONFIG_MODE = "allnoconfig"
KCONF_AUDIT_LEVEL = "0"
KCONF_BSP_AUDIT_LEVEL = "0"

# initial command line
# APPEND = "panic=120 net.ifnames=1 audit=1"

# used by systemd-serialgetty or shadow-securetty
# SERIAL_CONSOLES = "115200;ttyS1"

# machine specific boot packages
MACHINE_ESSENTIAL_EXTRA_RDEPENDS = ""
CORE_IMAGE_EXTRA_INSTALL:append = " distro-wsl-conf"

# KERNEL_MODULE_AUTOLOAD += "cdc-mbim qmi-wwan qcserial usb-wwan"

# KERNEL_MODULE_PROBECONF += "ath9k"
# module_conf_ath9k = "options ath9k debug=0 nohwcrypt=1 ps_enable=0"
# MACHINE_EXTRA_RDEPENDS += "linux-firmware-ath9k"

# ---
```
