## conf/machine/com-cexpress-sl.conf
```bitbake
# MACHINE.conf

# Aspects of build-in inclusion are denoted with the use of an OVERRIDE from
# MACHINEOVERRIDES. Where functionality is only available from a specific Yocto
# meta-* layer, incorporate the appropriate conditional checks and test with
# that layer absent.

# OVERRIDES             Description
# none                  default packagegroup, required even if empty
# :libc-glibc           additions for runtime glibc, locales
# :libc-musl            additions for runtime musl
# :<machine_arch>       additions for specific MACHINE

MACHINEOVERRIDES =. "intel-skylake-64:"
MACHINEOVERRIDES =. "qemux86-64:"

DEFAULTTUNE = "x86-64-v3"

require conf/machine/intel-skylake-64.conf

# machine features
MACHINE_FEATURES += "efi keyboard pci rtc screen serial usbgadget usbhost wifi qemu-usermode tpm tpm2"
MACHINE_FEATURES:remove = "intel-ucode alsa bluetooth pcbios pcmcia phone"

# preferred providers
# PREFERRED_PROVIDER_virtual/bootloader = "systemd-boot"
# PREFERRED_PROVIDER_virtual/kernel = "linux-yocto"
# PREFERRED_VERSION_linux-yocto = "6.%"

require conf/machine/include/machine-common.conf
require conf/machine/include/machine-uefi.conf
require conf/machine/include/machine-wic.conf
require conf/machine/include/machine-systemd-boot.conf

INITRAMFS_IMAGE = "initramfs"
INITRAMFS_IMAGE_BUNDLE = "0"

# kernel
# KCONF_AUDIT_LEVEL = "0"
# KCONF_BSP_AUDIT_LEVEL = "0"
# KCONFIG_BSP_AUDIT_LEVEL = "0"
KCONFIG_MODE = "--alldefconfig"

# KERNEL_FEATURES += ""

# initial command line
APPEND = "panic=120 net.ifnames=1 audit=1"

# used by systemd-serialgetty or shadow-securetty
SERIAL_CONSOLES = "115200;ttyS1"

# kernel modules
KERNEL_MODULE_AUTOLOAD ??= ""
KERNEL_MODULE_PROBECONF ??= ""

# KERNEL_MODULE_AUTOLOAD += "cdc-mbim qmi-wwan qcserial usb-wwan"

KERNEL_MODULE_PROBECONF += "i915"
module_conf_i915 = "options i915"
MACHINE_EXTRA_RDEPENDS += "linux-firmware-i915"

KERNEL_MODULE_PROBECONF += "rtl8188ee"
module_conf_rtl8188ee = "options rtl8188ee"
MACHINE_EXTRA_RDEPENDS += "linux-firmware-rtl8188"

# KERNEL_MODULE_PROBECONF += "ath9k"
# module_conf_ath9k = "blacklist ath9k"
# MACHINE_EXTRA_RDEPENDS += "linux-firmware-ath9k"

# KERNEL_MODULE_PROBECONF += "brcmdhd"
# module_conf_brcmdhd = "blacklist brcmdhd"
# MACHINE_EXTRA_RDEPENDS: += "linux-firmware-bcm4329-fullmac"

# ---
```

## conf/machine/include/machine-bootloader-grub-efi.inc
```bitbake
# conf/machine/include/machine-grub-efi.inc

# Used to supply boot parameters

GRUB_GFXSERIAL = "1"
GRUB_CFG = "grub${EFI_ARCH}.cfg"
GRUB_OPTS ?= "serial --unit=1 --speed=115200 --word=8 --parity=no --stop=1;terminal_input serial;terminal_output serial;"
GRUB_ROOT = "PARTUUID=${GPT_PART_UUID_ROOT}"
GRUB_SERIAL ?= "console=ttyS1,115200"
GRUB_TIMEOUT ?= "60"

# meta-secure-core
# INHERIT += "${@bb.utils.contains('DISTRO_FEATURES', 'efi-secure-boot', 'user-key-store', '', d)}"
# keys sample, user
# SIGNING_MODEL = "user"
# MOK_SB ?= "1"
# UEFI_SB ?= "1"
# UEFI_SELOADER ?= "1"
# GRUB_SIGN_VERIFY ?= "0"
# USER_KEY_SHOW_VERBOSE ?= "1"
# SYSTEM_TRUSTED_KEYS_DIR ?= "${TOPDIR}/../../layers/meta-signing-key/files/system_trusted_keys"
# SECONDARY_TRUSTED_KEYS_DIR ?= "${TOPDIR}/../../layers/meta-signing-key/files/secondary_trusted_keys"
# MODSIGN_KEYS_DIR ?= "${TOPDIR}/../../layers/meta-signing-key/files/modsign_keys"
# IMA_KEYS_DIR ?= "${TOPDIR}/../../layers/meta-signing-key/files/ima_keys"
# RPM_KEYS_DIR ?= "${TOPDIR}/../../layers/meta-signing-key/files/rpm_keys"
# BOOT_KEYS_DIR ?= "${TOPDIR}/../../layers/meta-signing-key/files/boot_keys"
# UEFI_SB_KEYS_DIR ?= "${TOPDIR}/../../layers/meta-signing-key/files/uefi_sb_keys"
# MOK_SB_KEYS_DIR ?= "${TOPDIR}/../../layers/meta-signing-key/files/mok_sb_keys"
# RPM_GPG_NAME ?= "SecureCore"
# BOOT_GPG_NAME ?= "SecureBootCore"
# BOOT_GPG_PASSPHRASE ?= ""

SIGNING_MODEL = "sample"
UEFI_SELOADER = "1"
GRUB_SIGN_VERIFY = "0"

# meta-updater
# OSTREE_BOOTLOADER = "grub"

# image-live class
# LABELS = ""
# ROOTFS = "${IMAGE_LINK_NAME}"
# INITRD = "${INITRAMFS_IMAGE}-${MACHINE}.${INITRAMFS_FSTYPES}"

BAD_RECOMMENDATIONS:pn-grub-efi += "systemd-boot systemd-bootconf"
BAD_RECOMMENDATIONS:pn-grub-bootconf += "systemd-boot systemd-bootconf"

BAD_RECOMMENDATIONS:pn-systemd-boot += "grub-efi grub-bootconf"
BAD_RECOMMENDATIONS:pn-systemd-bootconf += "grub-efi grub-bootconf"

# https://www.kernel.org/doc/html/v4.14/admin-guide/kernel-parameters.html

# selinux permissive/off
APPEND +="${@bb.utils.contains('DISTRO_FEATURES', 'selinux', 'selinux=1 enforcing=0', '', d)}"
# console settings
APPEND += "quiet loglevel=3 ${GRUB_SERIAL} console=tty1"
# vconsole settings https://www.kernel.org/doc/html/v5.5/admin-guide/svga.html
# vga=773 (1024x768x8), vga=791 (1024x768x16), vga=792 (1024x768x32), vga=3840 (80x25)
APPEND += "vga=792 logo.nologo"
# APPEND += "vconsole.keymap=us vconsole.font=Lat2-Terminus16"
# if "0", use kernel enumerated network names
# APPEND += "net.ifnames=0"
# if set, disables cgroupsv1
# APPEND += "cgroup_no_v1=all"
# if "1", enables cgroupsv2
APPEND += "${@bb.utils.contains('DISTRO_FEATURES', 'systemd', 'systemd.unified_cgroup_hierarchy=1', '', d)}"
# if set, inittialize ramdisk size KiB
# APPEND += "ramdisk_size=16384"
# debug initramfs-framework output
APPEND += "ignore_loglevel debug=true verbose=true"
APPEND += "shell=true shell_debug=true init_fatal_sh=true"
# debug systemd root shell (ALT+F9)
APPEND += "${@bb.utils.contains('DISTRO_FEATURES', 'systemd', 'systemd.debug-shell=on', '', d)}"



# ---
```

## conf/machine/include/machine-bootloader-none.inc
```bitbake
# conf/machine/include/machine-grub-efi.inc

# Used to supply boot parameters

# meta-secure-core
UEFI_SELOADER = "0"

# meta-updater
# OSTREE_BOOTLOADER = "none"

# https://www.kernel.org/doc/html/v4.14/admin-guide/kernel-parameters.html

# selinux permissive/off
APPEND +="${@bb.utils.contains('DISTRO_FEATURES', 'selinux', 'selinux=1 enforcing=0', '', d)}"
# console settings
APPEND += "quiet loglevel=3 ${GRUB_SERIAL} console=tty1"
# vconsole settings https://www.kernel.org/doc/html/v5.5/admin-guide/svga.html
# vga=773 (1024x768x8), vga=791 (1024x768x16), vga=792 (1024x768x32), vga=3840 (80x25)
APPEND += "vga=792 logo.nologo"
# APPEND += "vconsole.keymap=us vconsole.font=Lat2-Terminus16"
# if "0", use kernel enumerated network names
# APPEND += "net.ifnames=0"
# if set, disables cgroupsv1
# APPEND += "cgroup_no_v1=all"
# if "1", enables cgroupsv2
APPEND += "${@bb.utils.contains('DISTRO_FEATURES', 'systemd', 'systemd.unified_cgroup_hierarchy=1', '', d)}"
# if set, inittialize ramdisk size KiB
# APPEND += "ramdisk_size=16384"
# debug initramfs-framework output
APPEND += "ignore_loglevel debug=true verbose=true"
APPEND += "shell=true shell_debug=true init_fatal_sh=true"
# debug systemd root shell (ALT+F9)
APPEND += "${@bb.utils.contains('DISTRO_FEATURES', 'systemd', 'systemd.debug-shell=on', '', d)}"

# ---
```

## conf/machine/include/machine-bootloader-systemd-boot.inc
```bitbake
# conf/machine/include/machine-systemd-boot.inc

# Used to supply boot parameters

EFI_PROVIDER = "systemd-boot"

SYSTEMD_BOOT_CFG = "${S}/loader.conf"
# SYSTEMD_BOOT_ENTRIES ?= ""
SYSTEMD_BOOT_SERIAL ?= "console=ttyS1,115200"
SYSTEMD_BOOT_TIMEOUT ?= "60"

SYSTEMD_DEFAULT_TARGET = "multi-user.target"
SYSTEMD_DEFAULT_TARGET:distro-gui = "graphical.target"

# meta-secure-core
UEFI_SELOADER = "0"

# meta-updater
# OSTREE_BOOTLOADER = "none"

# image-live class
# LABELS = ""
# ROOTFS = "${IMAGE_LINK_NAME}"
# INITRD = "${INITRAMFS_IMAGE}-${MACHINE}.${INITRAMFS_FSTYPES}"

BAD_RECOMMENDATIONS:pn-systemd-boot += "grub-efi grub-bootconf"
BAD_RECOMMENDATIONS:pn-systemd-bootconf += "grub-efi grub-bootconf"

# https://www.kernel.org/doc/html/v4.14/admin-guide/kernel-parameters.html

# selinux permissive/off
APPEND +="${@bb.utils.contains('DISTRO_FEATURES', 'selinux', 'selinux=1 enforcing=0', '', d)}"
# console settings
APPEND += "quiet loglevel=3 ${SYSTEMD_BOOT_SERIAL} console=tty1"
# vconsole settings https://www.kernel.org/doc/html/v5.5/admin-guide/svga.html
# vga=773 (1024x768x8), vga=791 (1024x768x16), vga=792 (1024x768x32), vga=3840 (80x25)
APPEND += "vga=792 logo.nologo"
# APPEND += "vconsole.keymap=us vconsole.font=Lat2-Terminus16"
# if "0", use kernel enumerated network names
# APPEND += "net.ifnames=0"
# if set, disables cgroupsv1
# APPEND += "cgroup_no_v1=all"
# if "1", enables cgroupsv2
APPEND += "${@bb.utils.contains('DISTRO_FEATURES', 'systemd', 'systemd.unified_cgroup_hierarchy=1', '', d)}"
# if set, inittialize ramdisk size KiB
# APPEND += "ramdisk_size=16384"
# debug initramfs-framework output
APPEND += "ignore_loglevel debug=true verbose=true"
APPEND += "shell=true shell_debug=true init_fatal_sh=true"
# debug systemd root shell (ALT+F9)
APPEND += "${@bb.utils.contains('DISTRO_FEATURES', 'systemd', 'systemd.debug-shell=on', '', d)}"

# systemd-cryptsetup-generator
APPEND += "rd.luks.name=${FSYS_DEV_UUID_LUKS}=${FSYS_DEV_NAME_LUKS}"
# APPEND += "rd.luks.key=${FSYS_DEV_UUID_LUKS}=/etc/lukskey:LABEL=keydev"
# APPEND += "rd.luks.options=${FSYS_DEV_UUID_LUKS}=discard,..."

# lvm2-activation-generator
# APPEND += "rd.lvm.lv=vg0/root rd.lvm.lv=vg0/var_log rd.lvm.lv=vg0/var_log_audit rd.lvm.lv=vg0/var_lib"

# systemd-fstab-generator
# APPEND += "rd.systemd.mount-extra=UUID=${FSYS_DEV_UUID_ROOT}:/:${FSYS_DEV_TYPE_ROOT}:remount,rw,noatime"
# APPEND += "rd.systemd.mount-extra=UUID=${FSYS_DEV_UUID_ESP_FSTAB}:/efi:${FSYS_DEV_TYPE_ESP}:remount,rw,noatime,nodev,nosuid,noexec"
# APPEND += "rd.systemd.mount-extra=UUID=${FSYS_DEV_UUID_XBOOTLDR}:/boot:${FSYS_DEV_TYPE_XBOOTLDR}:remount,rw,noatime,nodev,nosuid,noexec"
# APPEND += "systemd.mount-extra=UUID=${FSYS_DEV_UUID_LIB}:/var/lib:${FSYS_DEV_TYPE_LIB}:auto,nofail,rw,noatime"
# APPEND += "systemd.mount-extra=UUID=${FSYS_DEV_UUID_LOG}:/var/log:${FSYS_DEV_TYPE_LOG}:auto,nofail,rw,noatime,nodev,nosuid,noexec"
# APPEND += "systemd.mount-extra=UUID=${FSYS_DEV_UUID_AUDIT}:/var/log/audit:${FSYS_DEV_TYPE_AUDIT}:auto,nofail,rw,noatime,nodev,nosuid,noexec"

# rootfs flags (systemd-bootconf)
ROOT = "root=UUID=${FSYS_DEV_UUID_ROOT}"
APPEND += "rootwait rw rootflags=noatime rootfstype=${FSYS_DEV_TYPE_ROOT}"
APPEND:append:sota = " ${ROOT}"

# ---
```

## conf/machine/include/machine-common.conf
```bitbake
# conf/machine/include/machine-common.conf

# Used to define common build settings

# inherit in image recipes (per image)
# INHERIT += " image_types_partition"

KERNEL_IMAGE_MAXSIZE = "32768"
# KERNEL_IMAGETYPE = "bzImage"
KERNEL_ARTIFACT_BIN_EXT = ""

# KERNEL_SPLIT_MODULES = "1"
# KERNEL_PACKAGE_NAME = "kernel"
KERNEL_VERSION_NAME = ""
# KERNEL_MODULE_PACKAGE_PREFIX = ""
KERNEL_MODULE_PACKAGE_SUFFIX = ""

IMAGE_NAME_SUFFIX = ""
# IMAGE_MACHINE_SUFFIX = ""

IMAGE_OVERHEAD_FACTOR = "1.2"
# maximum size of the rootfs KiB (4GiB=4194304, 8GiB=8388608, 16GiB=16777216)
IMAGE_ROOTFS_MAXSIZE = "16777216"
# remove extra space added by rootfs_rpm.bbclass
IMAGE_ROOTFS_EXTRA_SPACE:append = "${@bb.utils.contains('PACKAGE_INSTALL', 'dnf', ' - 102400', '', d)}"

# EXTRA_IMAGEDEPENDS:append = " ovmf"
# OVMF_SECURE_BOOT_EXTRA_FLAGS:x86-64 = "-D SMM_REQUIRE"

# meta-intel uefi-sign.bbclass
IMAGE_FEATURES[validitems] += "secureboot"
IMAGE_FEATURES += "secureboot"
SECURE_BOOT_SIGNING_CERT ?= "${METADIR}/meta-distro/files/user-keys/uefi_sb_keys/db.crt"
SECURE_BOOT_SIGNING_KEY ?= "${METADIR}/meta-distro/files/user-keys/uefi_sb_keys/db.key"

# insert per recipe that require signed EFI files:
# meta-intel
# inherit ${@bb.utils.contains('IMAGE_FEATURES', 'secureboot', 'uefi-sign', '', d)}

# meta-security/meta-integrity
MODSIGN_PRIVKEY ?= "${METADIR}/meta-distro/files/user-keys/modsign_keys/modsign_key.key"
MODSIGN_X509 ?= "${METADIR}/meta-distro/files/user-keys/modsign_keys/modsign_key.crt"
INHERIT += "${@bb.utils.contains('DISTRO_FEATURES', 'modsign', 'kernel-modsign', '', d)}"

# ---
```

## conf/machine/include/machine-common.inc
```bitbake
# conf/machine/include/machine-common.inc

# Used to define common build settings

# inherit in image recipes (per image)
# INHERIT += " image_types_partition"

KERNEL_IMAGE_MAXSIZE = "32768"
# KERNEL_IMAGETYPE = "bzImage"
KERNEL_ARTIFACT_BIN_EXT = ""

# KERNEL_SPLIT_MODULES = "1"
# KERNEL_PACKAGE_NAME = "kernel"
KERNEL_VERSION_NAME = ""
# KERNEL_MODULE_PACKAGE_PREFIX = ""
KERNEL_MODULE_PACKAGE_SUFFIX = ""

IMAGE_NAME_SUFFIX = ""
# IMAGE_MACHINE_SUFFIX = ""

IMAGE_OVERHEAD_FACTOR = "1.2"
# maximum size of the rootfs KiB (4GiB=4194304, 8GiB=8388608, 16GiB=16777216)
IMAGE_ROOTFS_MAXSIZE = "16777216"
# remove extra space added by rootfs_rpm.bbclass
IMAGE_ROOTFS_EXTRA_SPACE:append = "${@bb.utils.contains('PACKAGE_INSTALL', 'dnf', ' - 102400', '', d)}"

# EXTRA_IMAGEDEPENDS:append = " ovmf"
# OVMF_SECURE_BOOT_EXTRA_FLAGS:x86-64 = "-D SMM_REQUIRE"

# ---
```

## conf/machine/include/machine-grub-efi.conf
```bitbake
# require by MACHINE.conf

EFI_PROVIDER = "grub-efi"

# GRUB_GFXSERIAL = "1"
# GRUB_CFG = "grub${EFI_ARCH}.cfg"
# GRUB_OPTS = "serial --unit=1 --speed=115200 --word=8 --parity=no --stop=1;terminal_input serial;terminal_output serial;"
# GRUB_ROOT = "PARTUUID=${GPT_PART_UUID_ROOT}"
# GRUB_SERIAL = "console=ttyS1,115200"
# GRUB_TIMEOUT = "60"

# image-live class
# LABELS = ""
# ROOTFS = "${IMAGE_LINK_NAME}"
# INITRD = "${INITRAMFS_IMAGE}-${MACHINE}.${INITRAMFS_FSTYPES}"

BAD_RECOMMENDATIONS:pn-grub-efi += "systemd-boot systemd-bootconf"
BAD_RECOMMENDATIONS:pn-grub-efi += "systemd-boot systemd-bootconf"

# ---
```

## conf/machine/include/machine-providers.inc
```bitbake
# conf/machine/include/machine-providers.inc

# Used to pin specific packages and versions

# meta-intel providers
# PREFERRED_PROVIDER_virtual/kernel:intel-x86-common = "linux-intel"
# PREFERRED_VERSION_linux-intel = "6.8%"
# PREFERRED_VERSION_linux-intel-rt = "6.8%"

# meta-raspberrypi providers
# PREFERRED_PROVIDER_virtual/kernel:raspberrypi5 = "linux-raspberrypi"
# PREFERRED_VERSION_linux-raspberrypi:raspberrypi5 = "6.6%"
# PREFERRED_PROVIDER_virtual/xserver:raspberrypi5 ?= "xserver-xorg"
PREFERRED_PROVIDER_virtual/egl:raspberrypi5 ?= "${@bb.utils.contains('MACHINE_FEATURES', 'vc4graphics', 'mesa', 'userland', d)}"
PREFERRED_PROVIDER_virtual/libgles2:raspberrypi5 ?= "${@bb.utils.contains('MACHINE_FEATURES', 'vc4graphics', 'mesa', 'userland', d)}"
PREFERRED_PROVIDER_virtual/libgl:raspberrypi5 ?= "${@bb.utils.contains('MACHINE_FEATURES', 'vc4graphics', 'mesa', 'mesa-gl', d)}"
PREFERRED_PROVIDER_virtual/mesa:raspberrypi5 ?= "${@bb.utils.contains('MACHINE_FEATURES', 'vc4graphics', 'mesa', 'mesa-gl', d)}"
PREFERRED_PROVIDER_virtual/libgbm:raspberrypi5 ?= "${@bb.utils.contains('MACHINE_FEATURES', 'vc4graphics', 'mesa', 'mesa-gl', d)}"
PREFERRED_PROVIDER_vlc:raspberrypi5 ?= "rpidistro-vlc"
PREFERRED_PROVIDER_ffmpeg:raspberrypi5 ?= "rpidistro-ffmpeg"
PREFERRED_PROVIDER_libav:raspberrypi5 ?= "rpidistro-ffmpeg"
PREFERRED_PROVIDER_libpostproc:raspberrypi5 ?= "rpidistro-ffmpeg"
PREFERRED_PROVIDER_jpeg:raspberrypi5 ?= "jpeg"
PREFERRED_PROVIDER_virtual/libomxil:raspberrypi5 ?= "userland"
PREFERRED_PROVIDER_u-boot-default-script:raspberrypi5 ??= "rpi-u-boot-scr"

# meta-riscv providers
# PREFERRED_PROVIDER_virtual/kernel:sbc-pine64-star64 = "linux-raspberrypi"
RDEPENDS:packagegroup-distro-core:remove:sbc-pine64-star64 = "dmidecode"

# meta-tegra providers
# PREFERRED_PROVIDER_virtual/kernel:tegra = "linux-tegra"

# poky
# PREFERRED_PROVIDER_virtual/kernel:wsl-qemuxarm64 = "linux-yocto"
# PREFERRED_PROVIDER_virtual/kernel:wsl-qemux86-64 = "linux-yocto"

# ---
```
